## app/boards/shields/the_wedge/Kconfig.defconfig
```kconfig
if SHIELD_WEDGE_LEFT

config ZMK_KEYBOARD_NAME
    default "The Wedge"

config ZMK_SPLIT_ROLE_CENTRAL
    default y

endif

if SHIELD_WEDGE_LEFT || SHIELD_WEDGE_RIGHT 

config ZMK_SPLIT
    default y

CONFIG_ZMK_RGB_UNDERGLOW=y
CONFIG_WS2812_STRIP=y

endif 
```

## app/boards/shields/the_wedge/Kconfig.shield
```kconfig
config SHIELD_WEDGE_LEFT
    def_bool $(shields_list_contains,the_wedge_left)

config SHIELD_WEDGE_RIGHT
    def_bool $(shields_list_contains,the_wedge_right)
```
